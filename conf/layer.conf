## conf/layer.conf
```bitbake
# We have a conf and classes directory, add to BBPATH
BBPATH .= ":${LAYERDIR}"

# We have recipes-* directories, add to BBFILES
BBFILES += "${LAYERDIR}/recipes-*/*/*.bb \
            ${LAYERDIR}/recipes-*/*/*.bbappend"

BBFILE_COLLECTIONS += "rockchip-layer"
BBFILE_PATTERN_rockchip-layer = "^${LAYERDIR}/"
BBFILE_PRIORITY_rockchip-layer = "6"

LAYERDEPENDS_rockchip-layer = "core"
LAYERSERIES_COMPAT_rockchip-layer = "styhead walnascar"
```

## conf/machine/include/radxa-zero-3.inc
```bitbake
# Copyright (c) 2025 Bartosz Szostak
# This software is released under the MIT License.
# See the LICENSE file for more details.

require conf/machine/include/rk3566.inc

MACHINEOVERRIDES:prepend = "radxa-zero-3:"

UBOOT_MACHINE = "radxa-zero-3-rk3566_defconfig"

SERIAL_CONSOLES = "1500000;ttyS2"
```

## conf/machine/include/rk3566.inc
```bitbake
# Copyright (c) 2025 Bartosz Szostak
# This software is released under the MIT License.
# See the LICENSE file for more details.

require conf/machine/include/arm/armv8-2a/tune-cortexa55.inc
require conf/machine/include/rockchip.inc

MACHINEOVERRIDES:prepend = "rk3566:"

UBOOT_ENTRYPOINT = "0x06000000"
UBOOT_SUFFIX = "itb"
```

## conf/machine/include/rockchip.inc
```bitbake
# Copyright (c) 2025 Bartosz Szostak
# This software is released under the MIT License.
# See the LICENSE file for more details.

MACHINEOVERRIDES:prepend = "rockchip:"

PACKAGE_EXCLUDE = "kernel-image-*"
MACHINE_ESSENTIAL_EXTRA_RDEPENDS = "kernel-modules"

SPL_BINARY = "idbloader.img"

PREFERRED_PROVIDER_virtual/kernel = "linux-yocto"
KCONFIG_MODE = "alldefconfig"
KBUILD_DEFCONFIG = "defconfig"
KERNEL_CLASSES = "kernel-fitimage"
KERNEL_IMAGETYPE = "fitImage"

IMAGE_FSTYPES = "ext4 wic"
IMAGE_BOOT_FILES = "boot.scr ${KERNEL_IMAGETYPE}"

WKS_FILES = "sdimage-rockchip.wks.in"
WKS_FILE_DEPENDS = "u-boot"
```

## conf/machine/radxa-zero-3e.conf
```bitbake
# Copyright (c) 2025 Bartosz Szostak
# This software is released under the MIT License.
# See the LICENSE file for more details.

require conf/machine/include/radxa-zero-3.inc

KERNEL_DEVICETREE = "rockchip/rk3566-radxa-zero-3e.dtb"
```

## conf/machine/radxa-zero-3w.conf
```bitbake
# Copyright (c) 2025 Bartosz Szostak
# This software is released under the MIT License.
# See the LICENSE file for more details.

require conf/machine/include/radxa-zero-3.inc

MACHINE_ESSENTIAL_EXTRA_RDEPENDS:append = " kernel-module-aic8800"

KERNEL_DEVICETREE = "rockchip/rk3566-radxa-zero-3w.dtb"
```
